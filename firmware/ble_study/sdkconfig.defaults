## firmware/ble_study/sdkconfig.defaults
```kconfig
CONFIG_IDF_TARGET="esp32s3"
CONFIG_ESPTOOLPY_FLASHSIZE_2MB=y
CONFIG_PARTITION_TABLE_SINGLE_APP=y
CONFIG_BT_ENABLED=y
CONFIG_BT_NIMBLE_ENABLED=y
CONFIG_BT_NIMBLE_ROLE_CENTRAL=n
CONFIG_BT_NIMBLE_MAX_CONNECTIONS=1
CONFIG_BT_NIMBLE_SECURITY_ENABLE=y
CONFIG_BT_NIMBLE_SM_SC=y
CONFIG_BT_NIMBLE_SM_LEGACY=n
CONFIG_BT_NIMBLE_SM_SC_ONLY=1
CONFIG_BT_NIMBLE_SM_LVL=3
CONFIG_BT_NIMBLE_SM_SC_DEBUG_KEYS=n
CONFIG_BT_NIMBLE_NVS_PERSIST=y
CONFIG_BT_NIMBLE_HANDLE_REPEAT_PAIRING_DELETION=n
CONFIG_BT_NIMBLE_LOG_LEVEL_NONE=y
CONFIG_LOG_DEFAULT_LEVEL_WARN=y
CONFIG_BT_NIMBLE_MAX_BONDS=8
CONFIG_BT_NIMBLE_HOST_TASK_STACK_SIZE=32768
```

## firmware/idf/main/Kconfig.projbuild
```kconfig
menu "Auto Gauge application profile"
    config AG_SOFTWARE_BENCH
        bool "Run volatile software bench (simulated CAN/display/storage)"
        default n
        help
            Explicit development simulation. No GPIO, physical flash storage,
            CAN bus, BLE, panel, touch, OTA selection or SDK mark-valid calls.
            The default firmware remains blocked until a qualified board profile
            is supplied. This is not a profile for either user's unknown ESP32.
    config AG_NATIVE_PROFILE
        bool "Link unified native adapters with a locally supplied board profile"
        default n
        depends on !AG_SOFTWARE_BENCH
        help
            Links partition/reset/boot/TWAI/NimBLE/OTA adapters in one image.
            The weak board-profile getter returns NULL unless overridden by a
            trusted local board definition. A NULL profile activates nothing.
            Native build defaults supply secure NimBLE and development OTA map;
            no GPIO, credentials, trust keys or production health is invented.
endmenu
```

## firmware/ota_study/sdkconfig.defaults
```kconfig
CONFIG_IDF_TARGET="esp32s3"
CONFIG_ESPTOOLPY_FLASHSIZE_4MB=y
CONFIG_PARTITION_TABLE_TWO_OTA=y
CONFIG_BOOTLOADER_APP_ROLLBACK_ENABLE=y
CONFIG_BOOTLOADER_APP_ANTI_ROLLBACK=n
CONFIG_BT_ENABLED=n
CONFIG_LOG_DEFAULT_LEVEL_WARN=y
```

## firmware/platform_study/sdkconfig.defaults
```kconfig
CONFIG_IDF_TARGET="esp32s3"
CONFIG_ESPTOOLPY_FLASHSIZE_4MB=y
CONFIG_PARTITION_TABLE_CUSTOM=y
CONFIG_PARTITION_TABLE_CUSTOM_FILENAME="partitions.csv"
CONFIG_BOOTLOADER_APP_ROLLBACK_ENABLE=y
CONFIG_BOOTLOADER_APP_ANTI_ROLLBACK=n
CONFIG_BT_ENABLED=n
CONFIG_LOG_DEFAULT_LEVEL_WARN=y
```
